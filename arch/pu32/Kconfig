## arch/pu32/Kconfig
```kconfig
config PU32
	def_bool y
	select PRINTK_TIME
	select HAVE_DEBUG_BUGVERBOSE
	select NO_DMA
	select ARCH_32BIT_OFF_T
	select ARCH_USE_QUEUED_RWLOCKS
	select GENERIC_ATOMIC64
	select GENERIC_LIB_ASHLDI3
	select GENERIC_LIB_ASHRDI3
	select GENERIC_LIB_LSHRDI3
	select GENERIC_IOMAP
	select UACCESS_MEMCPY
	select GENERIC_SCHED_CLOCK
	select GENERIC_IRQ_SHOW
	select BUILDTIME_TABLE_SORT
	#select HAVE_CONTEXT_TRACKING
	#select CONTEXT_TRACKING
	select GENERIC_CPU_DEVICES if !NUMA
	select GENERIC_SMP_IDLE_THREAD
	select HAVE_IRQ_EXIT_ON_IRQ_STACK

config SMP
	def_bool n

config NR_CPUS
	int "Maximum number of CPUs"
	range 2 16
	depends on SMP
	default "16"

config HOTPLUG_CPU
	bool "Support for hot-pluggable CPUs"
	select GENERIC_IRQ_MIGRATION
	depends on SMP
	default y
	help
	  Say Y here to experiment with turning CPUs off and on.
	  CPUs can be controlled through /sys/devices/system/cpu/cpu#.
	  Say N if you want to disable CPU hotplug.

config MMU
	def_bool y

#config NUMA
#	bool "NUMA Memory Allocation and Scheduler Support"
#	depends on SMP && MMU
#	default n
#	select GENERIC_ARCH_NUMA
#	select ARCH_SUPPORTS_NUMA_BALANCING
#	help
#	  Enable NUMA (Non-Uniform Memory Access) support.

# Must be set to clog2(NR_CPUS)
config NODES_SHIFT
	int "Maximum NUMA Nodes (as a power of 2)"
	range 1 4
	default "4"
	depends on NEED_MULTIPLE_NODES
	help
	  Specify the maximum number of NUMA Nodes available on the target
	  system.  Increases memory reserved to accommodate various tables.

config USE_PERCPU_NUMA_NODE_ID
	def_bool y
	depends on NUMA

config HAVE_MEMORYLESS_NODES
	def_bool y
	depends on NUMA

config FPU
	def_bool n # Disable all floating-point related procedure in the kernel.

config HZ
        int
        default 100

config FORCE_MAX_ZONEORDER
        int
        default 13

# TODO: Must be kept 0 until there is a way to guarantee
# that kernel stacks are naturally aligned; otherwise checks
# such as (sp & ~(THREAD_SIZE-1)) will fail to compute
# the start of the stack.
config KERNEL_STACK_ORDER
	int "Kernel stack size order"
	default 0
	help
	  This option determines the size of kernel stacks.
	  They will be (1 << order) pages.

config GENERIC_HWEIGHT
	def_bool y

config GENERIC_CSUM
	def_bool y

config STACKTRACE_SUPPORT
	def_bool y

config LOCKDEP_SUPPORT
	def_bool  y

config HW_RANDOM
	default n

config RANDOM_TRUST_CPU
	def_bool y

config HWMON
	default n

config IOMMU_SUPPORT
	def_bool n

config HID
	default n

config INPUT_KEYBOARD
	def_bool n

config INPUT_MOUSE
	def_bool n

config SECURITY
	def_bool n

config USB_OHCI_LITTLE_ENDIAN
	def_bool n

config USB_SUPPORT
	def_bool n

config LCD_CLASS_DEVICE
	default n

config EARLY_PRINTK
	def_bool y

config PU32_DEBUG
	def_bool n
	select DEBUG_ATOMIC_SLEEP
	select SCHED_STACK_END_CHECK
	select DEBUG_PREEMPT
	select HAVE_DEBUG_KMEMLEAK
	select DEBUG_KMEMLEAK
	select DEBUG_KMEMLEAK_DEFAULT_OFF
	select DEBUG_MEMORY_INIT
	select ARCH_USE_MEMTEST
	select MEMTEST
	select RCU_EQS_DEBUG
	select PRINTK_CALLER
	select DEBUG_IRQFLAGS

source "arch/pu32/drivers/Kconfig"
```

## arch/pu32/configs/defconfig
```kconfig
# CONFIG_CROSS_MEMORY_ATTACH is not set
CONFIG_NO_HZ_IDLE=y
CONFIG_HIGH_RES_TIMERS=y
CONFIG_IKCONFIG=y
CONFIG_IKCONFIG_PROC=y
# CONFIG_MEMBARRIER is not set
CONFIG_KALLSYMS_ALL=y
CONFIG_EMBEDDED=y
CONFIG_PU32HDD=y
CONFIG_PU32GPIO=y
CONFIG_PU32FBDEV=y
# CONFIG_MQ_IOSCHED_DEADLINE is not set
# CONFIG_MQ_IOSCHED_KYBER is not set
CONFIG_BINFMT_MISC=y
# CONFIG_SLAB_MERGE_DEFAULT is not set
# CONFIG_VM_EVENT_COUNTERS is not set
CONFIG_NET=y
CONFIG_PACKET=y
CONFIG_PACKET_DIAG=y
CONFIG_UNIX=y
CONFIG_UNIX_DIAG=y
CONFIG_INET=y
CONFIG_INET_UDP_DIAG=y
CONFIG_INET_RAW_DIAG=y
CONFIG_INET_DIAG_DESTROY=y
# CONFIG_IPV6 is not set
CONFIG_NETLINK_DIAG=y
# CONFIG_WIRELESS is not set
# CONFIG_ETHTOOL_NETLINK is not set
CONFIG_DEVTMPFS=y
CONFIG_DEVTMPFS_MOUNT=y
# CONFIG_FW_LOADER is not set
CONFIG_BLK_DEV_LOOP=y
CONFIG_NETDEVICES=y
CONFIG_TUN=y
# CONFIG_ETHERNET is not set
# CONFIG_WLAN is not set
# CONFIG_SERIO is not set
CONFIG_VT_HW_CONSOLE_BINDING=y
# CONFIG_LEGACY_PTYS is not set
CONFIG_FB=y
# CONFIG_VGA_CONSOLE is not set
# CONFIG_VIRTIO_MENU is not set
# CONFIG_VHOST_MENU is not set
CONFIG_EXT4_FS=y
CONFIG_TMPFS=y
CONFIG_TMPFS_POSIX_ACL=y
# CONFIG_MISC_FILESYSTEMS is not set
# CONFIG_NETWORK_FILESYSTEMS is not set
CONFIG_INIT_STACK_NONE=y
# CONFIG_CRYPTO_HW is not set
# CONFIG_DEBUG_MISC is not set
# CONFIG_SLUB_DEBUG is not set
CONFIG_PANIC_TIMEOUT=1
CONFIG_SOFTLOCKUP_DETECTOR=y
CONFIG_WQ_WATCHDOG=y
CONFIG_STACKTRACE=y
# CONFIG_RCU_TRACE is not set
# CONFIG_RUNTIME_TESTING_MENU is not set
```

## arch/pu32/drivers/Kconfig
```kconfig
# SPDX-License-Identifier: GPL-2.0-only
# (c) William Fonkou Tambe

menu "PU32 Device Drivers"

source "arch/pu32/drivers/pu32hdd/Kconfig"
source "arch/pu32/drivers/pu32gpio/Kconfig"
source "arch/pu32/drivers/pu32fbdev/Kconfig"

endmenu
```

## arch/pu32/drivers/pu32fbdev/Kconfig
```kconfig
# SPDX-License-Identifier: GPL-2.0-only
# (c) William Fonkou Tambe

config PU32FBDEV
	tristate "PU32 FrameBuffer Device Driver"
	depends on FB && HIGH_RES_TIMERS
	select FB_CFB_FILLRECT
	select FB_CFB_COPYAREA
	select FB_CFB_IMAGEBLIT
	help
	  Support for PU32 FrameBuffer device.

	  To compile this driver as a module, choose M here,
	  the module will be called pu32fbdev.
```

## arch/pu32/drivers/pu32gpio/Kconfig
```kconfig
# SPDX-License-Identifier: GPL-2.0-only
# (c) William Fonkou Tambe

config PU32GPIO
	tristate "PU32 GPIO Device Driver"
	help
	  Support for PU32 GPIO device.

	  To compile this driver as a module, choose M here,
	  the module will be called pu32gpio.
```

## arch/pu32/drivers/pu32hdd/Kconfig
```kconfig
# SPDX-License-Identifier: GPL-2.0-only
# (c) William Fonkou Tambe

config PU32HDD
	tristate "PU32 HDD Block Device Driver"
	depends on BLK_DEV
	help
	  Support for the PU32 hard-disk-drive.

	  To compile this driver as a module, choose M here,
	  the module will be called pu32hdd.
```
